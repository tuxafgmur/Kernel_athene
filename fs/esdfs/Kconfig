## fs/esdfs/Kconfig
```kconfig
config ESD_FS
	tristate "Emulated 'SD card' file system for Android"
	depends on CONFIGFS_FS
	default n
	help
	  Esdfs is a wrapfs-based file system, designed to implement the
	  Android "sdcard" FUSE-backed file system from within the kernel.

	  It is assumed that only one of both (Esdfs nor Sdcardfs) emulation 
	  SD card file systems is to be selected.
```

## fs/sdcardfs/Kconfig
```kconfig
config SDCARD_FS
	tristate "Sdcard file system to emulate Android 'SD card"
	depends on CONFIGFS_FS
	default n
	help
  	  Sdcardfs is a wrapfs-based file system, designed to implement the
	  Android "sdcard" FUSE-backed file system from within the kernel.

	  It is assumed that only one of both (Sdcardfs nor Esdfs) emulation 
	  SD card file systems is to be selected.

config SDCARD_FS_FADV_NOACTIVE
	bool "sdcardfs fadvise noactive support"
	depends on FADV_NOACTIVE
	default y
	help
	  Sdcardfs supports fadvise noactive mode.
```
